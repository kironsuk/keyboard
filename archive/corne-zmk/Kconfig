## archive/corne-zmk/Kconfig
```kconfig
DT_COMPAT_ZMK_BEHAVIOR_BATTERY_OUTPUT := zmk,behavior-battery-output

config ZMK_BEHAVIOR_BATTERY_OUTPUT
    bool
    default $(dt_compat_enabled,$(DT_COMPAT_ZMK_BEHAVIOR_BATTERY_OUTPUT))
```

## archive/corne-zmk/dts/bindings/behaviors/zmk,behavior-battery-output.yaml
```yaml
# SPDX-License-Identifier: MIT

description: Battery percentage output behavior

compatible: "zmk,behavior-battery-output"

include: zero_param.yaml
```
